## sdkconfig.defaults
```kconfig
# micro-ROS 配置模板（脱敏版，提交到仓库用）
# 使用前请将 <your-*> 占位符替换为真实值：
#   idf.py menuconfig 或直接编辑本文件后 idf.py build

CONFIG_MICRO_ROS_APP_STACK=16000
CONFIG_MICRO_ROS_APP_TASK_PRIO=5
CONFIG_MICRO_ROS_DOMAIN_ID=20
CONFIG_MICRO_ROS_NAMESPACE=""

# micro-ROS Agent 地址（上位机树莓派 IP 与端口）
CONFIG_MICRO_ROS_AGENT_IP="<your-agent-ip>"
CONFIG_MICRO_ROS_AGENT_PORT="8888"

# WiFi（请填入你的网络）
CONFIG_ESP_WIFI_SSID="<your-wifi-ssid>"
CONFIG_ESP_WIFI_PASSWORD="<your-wifi-password>"
```
